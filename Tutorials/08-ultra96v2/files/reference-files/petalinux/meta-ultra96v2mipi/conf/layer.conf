## Tutorials/08-ultra96v2/files/reference-files/petalinux/meta-ultra96v2mipi/conf/layer.conf
```bitbake
# We have a conf and classes directory, add to BBPATH
BBPATH .= ":${LAYERDIR}"

# We have recipes-* directories, add to BBFILES
BBFILES += "${LAYERDIR}/recipes-*/*/*.bb \
	${LAYERDIR}/recipes-*/*/*.bbappend"

BBFILE_COLLECTIONS += "meta-bsp"
BBFILE_PATTERN_meta-bsp = "^${LAYERDIR}/"
BBFILE_PRIORITY_meta-bsp = "9"
LAYERSERIES_COMPAT_meta-bsp = "thud"
```
